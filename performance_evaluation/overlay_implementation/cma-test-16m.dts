/dts-v1/;
/plugin/;

/ {
    compatible = "brcm,bcm2712";

    fragment@0 {
        target-path = "/reserved-memory/linux,cma";
        __overlay__ {
            reg = <0x0 0x3a000000 0x0 0x1000000>;
        };
    };
};
